## firmware/orbo/main/Kconfig.projbuild
```kconfig
menu "Orbo production controller"
config ORBO_DXL_TX
    int "Dynamixel TX GPIO"
    default 43
config ORBO_DXL_RX
    int "Dynamixel RX GPIO"
    default 44
config ORBO_DXL_BAUD
    int "Dynamixel baud"
    default 1000000
config ORBO_LEFT_ID
    int "Left XL430 ID"
    default 1
config ORBO_RIGHT_ID
    int "Right XL430 ID"
    default 2
config ORBO_LEFT_SIGN
    int "Calibrated left direction (+1 or -1)"
    default 1
config ORBO_RIGHT_SIGN
    int "Calibrated right direction (+1 or -1)"
    default -1
config ORBO_MAX_MRAD_S
    int "Engineering wheel bound in milliradians per second"
    default 2000
config ORBO_PROFILE_ACCEL
    int "XL430 Profile Acceleration raw value"
    default 40
config ORBO_FLIPPER_LEFT_GPIO
    int "Left PWM native GPIO (Nano D7 = GPIO10; -1 disabled)"
    default 10
config ORBO_FLIPPER_RIGHT_GPIO
    int "Right PWM native GPIO (Nano D10 = GPIO21; -1 disabled)"
    default 21
config ORBO_FLIPPER_MIN_US
    int "Measured minimum safe pulse (0 uncommissioned)"
    default 0
config ORBO_FLIPPER_MAX_US
    int "Measured maximum safe pulse (0 uncommissioned)"
    default 0
config ORBO_FLIPPER_REST_US
    int "Measured rest pulse (0 uncommissioned)"
    default 0
config ORBO_ROS_DOMAIN_ID
    int "Isolated robot ROS domain"
    default 42
config ORBO_WHEELS_CALIBRATED
    bool "Enable explicitly commissioned wheel profile"
    default n
config ORBO_FLIPPERS_CALIBRATED
    bool "Enable explicitly commissioned flippers"
    default n
endmenu
```

## firmware/orbo/sdkconfig.defaults
```kconfig
CONFIG_IDF_TARGET="esp32s3"
CONFIG_ESP_MAIN_TASK_STACK_SIZE=4096
CONFIG_FREERTOS_HZ=1000
CONFIG_MICRO_ROS_ESP_XRCE_DDS_MIDDLEWARE=y
CONFIG_MICRO_ROS_ESP_UART_TRANSPORT=y
CONFIG_TINYUSB_CDC_ENABLED=y
CONFIG_TINYUSB_CDC_COUNT=2
# CONFIG_ESP_CONSOLE_UART_DEFAULT is not set
CONFIG_ESP_CONSOLE_USB_SERIAL_JTAG=n
CONFIG_ESP_TASK_WDT_EN=y
CONFIG_ESP_TASK_WDT_INIT=y
CONFIG_ESP_TASK_WDT_TIMEOUT_S=2

CONFIG_ESP_CONSOLE_NONE=y
```

## prototypes/teleop/firmware/main/Kconfig.projbuild
```kconfig
menu "Teleop robot"

    config TELEOP_NAME
        string "Robot name"
        default "PetBot"

    config TELEOP_DXL_TX
        int "DYNAMIXEL TX GPIO (board pin TX1)"
        default 43

    config TELEOP_DXL_RX
        int "DYNAMIXEL RX GPIO (board pin RX0, jumpered to TX1)"
        default 44

    config TELEOP_DXL_BAUD
        int "DYNAMIXEL baud rate"
        default 1000000

    config TELEOP_ID_LEFT
        int "Left motor ID"
        default 1

    config TELEOP_ID_RIGHT
        int "Right motor ID"
        default 2

    config TELEOP_MAX_RPM
        int "Top wheel speed (rpm, XL430 limit is about 57 on 3S)"
        default 55

    config TELEOP_ACCEL
        int "Motor ramp (Profile Acceleration, 214.6 rev/min^2 per unit, 0 = none)"
        default 40

    config TELEOP_WATCHDOG_MS
        int "Stop the wheels after this long without a command (ms)"
        default 500

    config TELEOP_WIFI_SSID
        string "Wi-Fi network the robot creates"
        default "PetBot"

    config TELEOP_WIFI_PASS
        string "Its password (8 or more characters)"
        default "petbot123"

    config TELEOP_WIFI_CHANNEL
        int "Wi-Fi channel"
        default 6

    config TELEOP_UDP_PORT
        int "UDP port"
        default 5005

endmenu
```
